## bootloader/boards/lily/lily_ultra/Kconfig.lily_ultra_left
```kconfig
# SPDX-License-Identifier: MIT

config BOARD_LILY_ULTRA_LEFT
	select SOC_NRF54LM20A_CPUAPP if BOARD_LILY_ULTRA_LEFT_NRF54LM20A_CPUAPP
```

## bootloader/boards/lily/lily_ultra/Kconfig.lily_ultra_right
```kconfig
# SPDX-License-Identifier: MIT

config BOARD_LILY_ULTRA_RIGHT
	select SOC_NRF54LM20A_CPUAPP if BOARD_LILY_ULTRA_RIGHT_NRF54LM20A_CPUAPP
```

## bootloader/boards/lily/lily_ultra/board.yml
```yaml
boards:
  - name: lily_ultra_left
    full_name: Lily Ultra (left half)
    vendor: lily
    socs:
      - name: nrf54lm20a
  - name: lily_ultra_right
    full_name: Lily Ultra (right half)
    vendor: lily
    socs:
      - name: nrf54lm20a
```

## bootloader/boards/lily/lily_ultra/lily_ultra_left_nrf54lm20a_cpuapp_defconfig
```kconfig
# SPDX-License-Identifier: MIT
CONFIG_GPIO=y
CONFIG_ARM_MPU=y
CONFIG_HW_STACK_PROTECTION=y
# 0x0-0x400 is unmapped on this target.
CONFIG_NULL_POINTER_EXCEPTION_DETECTION_NONE=y
CONFIG_CACHE_MANAGEMENT=y
CONFIG_EXTERNAL_CACHE=y
CONFIG_NRF_GRTC_START_SYSCOUNTER=y
```
