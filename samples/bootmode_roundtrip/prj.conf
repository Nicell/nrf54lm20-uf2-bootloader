## CMakeLists.txt
```
# SPDX-License-Identifier: MIT
cmake_minimum_required(VERSION 3.20.0)

# Pick up the Lily Ultra boards from the bootloader directory.
list(APPEND BOARD_ROOT ${CMAKE_CURRENT_SOURCE_DIR}/../../bootloader)
list(APPEND DTS_ROOT ${CMAKE_CURRENT_SOURCE_DIR}/../../bootloader)

find_package(Zephyr REQUIRED HINTS $ENV{ZEPHYR_BASE})
project(bootmode_roundtrip LANGUAGES C)
target_sources(app PRIVATE src/main.c)

# Zephyr 4.4's CONFIG_BUILD_OUTPUT_UF2 passes an empty base address when the
# board uses zephyr,mapped-partition (CONFIG_FLASH_LOAD_OFFSET is never
# defined). Convert from the .hex instead, which carries absolute addresses.
set(UF2_FAMILY_ID 0x4ED75C3F)
add_custom_target(uf2 ALL
  COMMAND ${PYTHON_EXECUTABLE} ${ZEPHYR_BASE}/scripts/build/uf2conv.py
          -c -f ${UF2_FAMILY_ID} -o ${CMAKE_BINARY_DIR}/zephyr/zephyr.uf2
          ${CMAKE_BINARY_DIR}/zephyr/zephyr.hex
  BYPRODUCTS ${CMAKE_BINARY_DIR}/zephyr/zephyr.uf2
  COMMENT "Generating zephyr.uf2 from zephyr.hex"
)
add_dependencies(uf2 zephyr_final)
```

## prj.conf
```kconfig
# Test app for the UF2 bootloader: boots from slot0, logs over RTT, then
# asks for the bootloader the same way ZMK's &bootloader does.
CONFIG_USE_DT_CODE_PARTITION=y

CONFIG_RETAINED_MEM=y
CONFIG_RETENTION=y
CONFIG_RETENTION_BOOT_MODE=y
CONFIG_REBOOT=y

CONFIG_CONSOLE=y
CONFIG_UART_CONSOLE=n
CONFIG_SERIAL=n
CONFIG_USE_SEGGER_RTT=y
CONFIG_RTT_CONSOLE=y
```

## src/main.c
```c
/*
 * SPDX-License-Identifier: MIT
 *
 * Round-trip test: print a few lines from slot0, then set boot mode
 * BOOTLOADER and warm-reboot, exactly as ZMK's &bootloader does. The
 * UF2 drive should come back.
 */

#include <zephyr/kernel.h>
#include <zephyr/retention/bootmode.h>
#include <zephyr/sys/printk.h>
#include <zephyr/sys/reboot.h>

#define SECONDS 5

int main(void)
{
	printk("roundtrip app running from slot0 (built " __DATE__ " " __TIME__ ")\n");
	for (int i = SECONDS; i > 0; i--) {
		printk("back to bootloader in %d\n", i);
		k_sleep(K_SECONDS(1));
	}
	printk("bootmode_set(BOOTLOADER) -> %d, rebooting\n", bootmode_set(BOOT_MODE_TYPE_BOOTLOADER));
	k_sleep(K_MSEC(10));
	sys_reboot(SYS_REBOOT_WARM);
	return 0;
}
```
